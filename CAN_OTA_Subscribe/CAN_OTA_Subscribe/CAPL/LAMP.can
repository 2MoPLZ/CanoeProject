/*@!Encoding:65001*/
includes
{
  
}

variables
{
  
}

on message B_CAN::msg_ieb_brake{
  if (this.sig_ieb_brake == 1) {
    @LAMP_UNIT::BrakeLamp = 1;
    write("브레이크등 ON");
  } else {
    @LAMP_UNIT::BrakeLamp = 0;
    write("브레이크등 OFF");
  }
}
