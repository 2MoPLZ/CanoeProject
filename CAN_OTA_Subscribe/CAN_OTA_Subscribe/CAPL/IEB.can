/*@!Encoding:65001*/
includes
{
  
}

variables {
  message C_CAN::msg_ieb_brake brakeMsg;
  message C_CAN::msg_adas_ieb ADAS_IEB_E_CAN;
  
  msTimer btnPollTimer;
  int btn;
  int flag = 0;
}

on start {
  setTimer(btnPollTimer, 50);
}

on sysvar IEB::BrakePedal {
  if (flag) {
    brakeMsg.sig_ieb_brake = 1;
    output(brakeMsg);
  } else {
    brakeMsg.sig_ieb_brake = @this;
    output(brakeMsg);
  }
}


on message C_CAN::msg_adas_ieb {
  if(this.sig_adas_ieb_cmd && !flag) {
    brakeMsg.sig_ieb_brake = this.sig_adas_ieb_cmd;
    output(brakeMsg);
    flag = 1;
  } else if (!this.sig_adas_ieb_cmd && flag) {
    brakeMsg.sig_ieb_brake = this.sig_adas_ieb_cmd;
    output(brakeMsg);
    flag = 0;
  }
  
}