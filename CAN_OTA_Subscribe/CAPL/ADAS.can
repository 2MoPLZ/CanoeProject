/*@!Encoding:949*/
includes
{
}

variables
{
  msTimer checkTimer;         
  float speed = 13.9; // 50 km/h × 0.27778 ≒ 13.89 m/s    
  float radarDistance = 0.0;   
  float brakeDistance = 0.0; 
  message msg_adas_ieb msg;
}

on start
{
  setTimer(checkTimer, 100); 
}

on timer checkTimer
{
  brakeDistance = (speed * speed) / (2.0 * 9.8); 

  if (radarDistance > 0.1 && radarDistance < brakeDistance)
  {
    msg.sig_adas_ieb_cmd = 1;
    output(msg);
  }
  
  else
  {
    msg.sig_adas_ieb_cmd = 0;
    output(msg);
  }

  setTimer(checkTimer, 100); 
}

on sysvar ADAS::Rader
{
  radarDistance = @this;
}
