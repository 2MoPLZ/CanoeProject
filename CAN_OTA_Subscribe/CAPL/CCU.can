/*@!Encoding:65001*/
includes
{
  //#include "ota.can"
}

variables {
  message C_CAN::msg_ieb_brake Brake_Status;     // C-CAN 수신 메시지
  message B_CAN::msg_ieb_brake Brake_Status_BCAN;     // B-CAN 전송 메시지
  
  message E_CAN::msg_adas_ieb Adas_Ieb;
  message B_CAN::msg_adas_ieb Adas_Ieb_BCAN;
  message C_CAN::msg_adas_ieb Adas_Ieb_CCAN;
}
on message E_CAN::msg_adas_ieb {
  Adas_Ieb_BCAN = this;
  Adas_Ieb_CCAN = this;
  output(Adas_Ieb_BCAN);
  output(Adas_Ieb_CCAN);
}

on message C_CAN::msg_ieb_brake {
  // C-CAN에서 수신 시 B-CAN으로 복사해서 중계
  Brake_Status_BCAN.sig_ieb_brake = this.sig_ieb_brake;
  output(Brake_Status_BCAN);
  write("CCU: C-CAN → B-CAN 제동 신호 중계됨 (%d)", this.sig_ieb_brake);
}

on key '1' {
  //printFile("test.txt");
}

