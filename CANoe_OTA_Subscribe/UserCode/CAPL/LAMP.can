/*@!Encoding:65001*/
/*@!Encoding:949*/
includes
{
}

variables
{
  dword timerCount = 0;
     
  float speed = 13.9; // 50 km/h × 0.27778 ≒ 13.89 m/s    
  float radarDistance = 0.0;   
  float brakeDistance = 0.0; 
  message msg_adas_ieb msg;
  
  char ECU_NAME[20] = "LAMP_UNIT";
  message 0x000 ISOTP_MSG;
  int recievedLen=0;
  byte recieved[4098];
  int rxIndex;
  byte sn;
  byte rxExpectedSN = 1;
  int rxInProgress;
  int currentService;
  int ambientFlag = 0;
  msTimer loop;
  
  /////////////진단///////////
  dword timerCountShortTermAdj = 0;
  byte on_shortTermAdj = 0;
  
  int service_request_buffer_index = 0;
  
  message msg_mood_diag_response response_msg;
  word DID_controlled_by_shortTermAdj; //shortTermAdj로 제어하는 항목의 DID 저장용
  int i;
  
  enum SID
  {
    EcuReset = 0x11,
    ReadDataByIdentifier = 0x22,
    WriteDataByIdentifier = 0x2E,
    InputOutputControlByIdentifier = 0x2F
  };
  
  enum io_control_option{
    returnControlToECU = 0x00,
    resetToDefault = 0x01,
    freezeCurrentState = 0x02,
    shortTermAdjustment = 0x03
  };
  
  enum DIDs{ 
    DID_BREAK_LAMP = 0xFD00, //제동등 ON/OFF STATE
    DID_DUMMY = 0x332
  };
  
  /////////////송수신
  char tx_buffer[4098];
  int tx_packet_size;
  
  char rx_buffer[4098];
  int rx_packet_size;
  
  ///////////////////ecu 데이터 정의
  struct brakeLamp_data_t{
    byte control_mode; //returnControlToECU OR freeze OR shortTermAdj
    byte original_data; //기존 상태 저장용.
    byte controlled_data; 
  };
  struct brakeLamp_data_t brakeLamp_data;
  byte control_state_to_brakeLamp_data[2] = {0x0,0x1};
  
  float lamp_unit_supply_voltage;

}

on start
{ 
  //ecu 데이터들 초기화
  brakeLamp_data.control_mode = returnControlToECU;
  @LAMP_UNIT::BrakeLamp = 0;
  
  setTimerCyclic(loop, 100);
}

on message B_CAN::msg_ieb_brake{
  
  byte brakeLamp_input;
  brakeLamp_input = this.sig_ieb_brake;
  
  if(brakeLamp_data.control_mode == returnControlToECU)
  {
    if (brakeLamp_input == 1)
    {
      @LAMP_UNIT::BrakeLamp = 1;
      write("브레이크등 ON");
    } else {
      @LAMP_UNIT::BrakeLamp = 0;
      write("브레이크등 OFF");
    }
  }
  else //강제구동, freeze OR shortTermAdjustment
  {
    brakeLamp_data.original_data = @LAMP_UNIT::BrakeLamp;
    @LAMP_UNIT::BrakeLamp = brakeLamp_data.controlled_data;
  }
}
on timer loop
{
  if(timerCount == 0xffffffff)
  {
    timerCount=0;
  }
  else
  {
    timerCount++;
  }
 
  //강제구동용 타이머 처리
  timerCountShortTermAdj++;
  if(on_shortTermAdj && timerCountShortTermAdj >= 30)
  {
    on_shortTermAdj = 0;
    shortTermAdjustment_recovery();
  }
  ///////////////////
}
//진단 서비스 요청 처리, //진단 프레임은 ISO-TP로 전역 버퍼에 받음
void process_diag_request(byte buffer_service_request[])
{
  byte SID;
  byte SF;
  word DID;
  byte CONTROL_OPTION;
  byte CONTROL_STATE;
  byte NRC;
  
  NRC = 0x00;  
  SID = buffer_service_request[0];
  
  write("execute diag service");
  
  
  switch (SID)
  {
    case EcuReset:
    {
      SF = buffer_service_request[1];
      //process reset routine
      response_msg.byte(0) = SID + 0x40;
      response_msg.byte(1) = SF;
      break;
    }
    case ReadDataByIdentifier:
    {
      DID = (buffer_service_request[1] << 8) | buffer_service_request[2];
      //DID에 맞게 값 넣어주기-switch-case
      response_msg.byte(0) = SID + 0x40;
      response_msg.word(1) = DID;
      //읽어온 데이터를 응답 프레임에 추가해야함
      break;
    }
    case WriteDataByIdentifier:
    {
      DID = (buffer_service_request[1] << 8) | buffer_service_request[2];
      //DID에 맞게 값 쓰기-switch-case
      response_msg.byte(0) = SID + 0x40;
      response_msg.word(1) = DID;
      break;
    }
    case InputOutputControlByIdentifier:
    {
      DID = (buffer_service_request[1] << 8) | buffer_service_request[2];
      CONTROL_OPTION = buffer_service_request[3];
      switch (CONTROL_OPTION)
      {
        //시그널 내보내는 코드에서는 data_control_master 상태를 보고 
        //출력을 data_controlled_value로 마스킹할 지 판단
        //출력은 output 시그널이 아니라 하드웨어 state가 될 수도 있음.
        //이 경우엔 값을 직접 바꾸고 강제구동이 종료되면 기존 값을 복구하는 방식 사용
        case returnControlToECU:
          NRC = handler_returnControlToECU(DID);
          break;
        case resetToDefault:
          NRC = handler_resetDefault(DID);
          break;
        case freezeCurrentState:
          NRC = handler_freezeCurrentState(DID);
          break;
        case shortTermAdjustment:
          CONTROL_STATE = buffer_service_request[4];
          write("sid : %d, did: %d, option: %d, state:%d",SID,DID,CONTROL_OPTION,CONTROL_STATE);
          NRC = handler_shortTermAdjustment(DID,CONTROL_STATE);
          break;
        default:
          //부정 응답, 지원하지 않는 제어 옵션
          NRC = 0x13;
          break;
      }
      
      if(NRC != 0) //negative response
      {
        response_msg.byte(0) = 0x7F; //negative response
        response_msg.byte(1) = SID;
        response_msg.byte(2) = NRC; //에러코드
      }
      else    //positive response
      {
        response_msg.byte(0) = SID + 0x40;
        response_msg.word(1) = DID;
        response_msg.byte(3) = CONTROL_OPTION;
        response_msg.byte(4) = CONTROL_STATE;
      }
      break;
    }
    default: //지원하지 않는 서비스, 부정응답
    {  
      NRC = 0x11;
      response_msg.byte(0) = 0x7F; //negative response
      response_msg.byte(1) = SID;
      response_msg.byte(2) = NRC; //에러코드
      break;
    }
  }
  output(response_msg);
}
byte handler_returnControlToECU(word DID)
{
  byte NRC;
  NRC = 0;
   
  switch (DID) {
    case DID_BREAK_LAMP:
      brakeLamp_data.control_mode = returnControlToECU;
      @LAMP_UNIT::BrakeLamp = brakeLamp_data.original_data;//기존 상태 복원
      break;
    default:
      break;
  }
  
  return NRC;
}
byte handler_resetDefault(word DID)
{
  byte NRC;
  NRC = 0;
  
  switch (DID) {
    case DID_BREAK_LAMP:
      @LAMP_UNIT::BrakeLamp = 0x0;
      break;
    default:
      break;
  }
  
  return NRC;
}
byte handler_freezeCurrentState(word DID)
{
  byte NRC;
  NRC = 0;

  switch (DID){
    case DID_BREAK_LAMP:
      //램프 상태 조정하는 코드에서는 freeze상태면 data_original_value[index_of_DID]에 값을 저장한다.
      if(brakeLamp_data.control_mode == shortTermAdjustment)
      {
        on_shortTermAdj = 0;
      }
      brakeLamp_data.controlled_data = @LAMP_UNIT::BrakeLamp;
      brakeLamp_data.control_mode = freezeCurrentState;
      break;
    default:
      break;
  }
  
  return NRC;
}
void shortTermAdjustment_recovery(void)
{
  word DID;
  DID = DID_controlled_by_shortTermAdj;
  
  //postprocess
  switch (DID) {
    case DID_BREAK_LAMP:
      brakeLamp_data.control_mode = returnControlToECU;
      @LAMP_UNIT::BrakeLamp = brakeLamp_data.original_data;
      break;
    default:
      break;
  }
}
int handler_shortTermAdjustment(word DID,byte CONTROL_STATE)
{
  byte NRC;
  NRC = 0;
  DID_controlled_by_shortTermAdj = DID;//타이머에서 사용
  
  switch (DID){
    case DID_BREAK_LAMP:
      brakeLamp_data.original_data = @LAMP_UNIT::BrakeLamp;//현재 상태 저장
      brakeLamp_data.controlled_data = control_state_to_brakeLamp_data[CONTROL_STATE];
      brakeLamp_data.control_mode = shortTermAdjustment;
      @LAMP_UNIT::BrakeLamp = brakeLamp_data.controlled_data;
      break;
    default:
      break;
  }
  
  timerCountShortTermAdj = 0;
  on_shortTermAdj = 1;
  
  return NRC;
}


// 수신 데이터 파일로 저장
void saveToFile()
{
  char file_version[10] = "1.0";
  char file_path[50] = "C:/TEAM_2_OTA/Files/";
  char file_name[50] = "";
  char downloadData[4098];
  int downloadSize;
  dword fd;
  int i;
  downloadSize = 0;
  snprintf(file_name,50,"%s_Firmware_%s.txt",ECU_NAME,file_version);
  for(i=2; i<recievedLen;i++){
    downloadData[downloadSize++]=(char)recieved[i];
  }
  downloadData[downloadSize]='\0';
  setWritePath(file_path);
  fd = openFileWrite(file_name,0);
  if (fd == -1)
  {
    write("!! 파일 열기 실패: %s", file_name);
    return;
  }
  filePutString(downloadData, downloadSize, fd);
  write(">> 파일 저장 성공:%d %s",downloadSize, file_name);
  fileClose(fd);
}


void sendISOTP(dword target_address,byte data[], int len)
{
  int i;
  int index;
  int seqNum;
  message 0x7DF outmsg;//브로드캐스트(사용안함)
  
  index = 0;
  seqNum = 1;

  ISOTP_MSG.id = target_address;
  
  if (len <= 7)//single frame
  {

    ISOTP_MSG.byte(0) = 0x00 | len;
    for (i = 0; i < len; i++) ISOTP_MSG.byte(i+1) = data[i];
    for (i = len + 1; i < 8; i++) ISOTP_MSG.byte(i) = 0x00;
    ISOTP_MSG.dlc = len+1;
    
    output(ISOTP_MSG);
  }
  else//ff -> cf
  {
    ISOTP_MSG.byte(0) = 0x10 | ((len >> 8) & 0x0F);
    ISOTP_MSG.byte(1) = len & 0xFF;
    for (i = 0; i < 6; i++) ISOTP_MSG.byte(i+2) = data[index++];
    ISOTP_MSG.dlc = len+2;
    output(ISOTP_MSG);
    
    //flow control을 받은 다음 cf를 보내기 시작해야하는데, 그부분은 미구현. (flow control 없이 그냥 파일 전송)
    while (index < len)
    {
      int rest;
      int cfLen;
      ISOTP_MSG.byte(0) = 0x20 | (seqNum & 0x0F);
      rest = len - index;
      cfLen = (rest >= 7) ? 7 : rest;

      for (i = 0; i < cfLen; i++) ISOTP_MSG.byte(i+1) = data[index++];
      
      ISOTP_MSG.dlc = cfLen+1;
      output(ISOTP_MSG);

      seqNum++;
    }
  }
}

// 수신 메시지 핸들러 
// ***************CAN ID를 ECU마다 다르게 수정해야 함*****************
on message msg_lamp_unit_diag_request
{  
  byte pci; 
  byte sid;
  int i;
  byte response[8];
  byte buffer_service_request[4098]; 
  byte fc[3];//flow control message
  
  

  pci = this.byte(0);
  

  
  // Single Frame
  if ((pci & 0xF0) == 0x00)
  {
    
    recievedLen = pci & 0x0F;
    sid = this.byte(1);

    currentService = sid;

    //request에 대한 응답
    response[0] = sid + 0x40;
    response[1] = 0x00; // Dummy positive response data
    sendISOTP(0x75D,response,2);

    // TransferData (0x36)이면 수신 대기
    if (sid == 0x36)
    {
  
      rxIndex = 0;
      rxInProgress = 1;
    }
    else if(sid == 0x37){
      
      ambientFlag = 1;
    }
    else{
      
      for(i=0;i<recievedLen;i++){
        buffer_service_request[i] = this.byte(i+1);
      }
      process_diag_request(buffer_service_request);
    }
  
  }
  // First Frame이 왔으면 응답후 CF 받기 시작
  else if ((pci & 0xF0) == 0x10)
  {
   
    recievedLen = ((pci & 0x0F) << 8) | this.byte(1);
    
    rxIndex = 0;

    for (i = 0; i < 6; i++)
      recieved[rxIndex++] = this.byte(i + 2);

    currentService = recieved[0]; // SID
    rxExpectedSN = 1;
    rxInProgress = 1;


    // FC (Flow Control) 응답 - 받을 블럭 크기랑 ST를 여기서 결정
    fc[0]=0x30;
    fc[1]=0x00;
    fc[2]=0x00;
    sendISOTP(0x75D,fc,3);
  }

  // Consecutive Frame
  else if ((pci & 0xF0) == 0x20)
  {
    int rest;
    int copyLen;
    sn = pci & 0x0F;
    
    if (!rxInProgress) return;

    if (sn != (rxExpectedSN & 0x0F))
    {
      write("!! ADAS : SN mismatch. Expected %d, got %d", rxExpectedSN, sn);
      rxInProgress = 0;
      return;
    }

    rxExpectedSN++;

    rest = recievedLen - rxIndex;
    copyLen = (rest >= 7) ? 7 : rest;

    for (i = 0; i < copyLen; i++)
      recieved[rxIndex++] = this.byte(i + 1);

    if (rxIndex >= recievedLen)
    {
      byte rsp[3];
      rsp[0]=0x03;
      rsp[1]=0x76;
      rsp[2]=0x01;
      rxInProgress = 0;
      write(">> Data reception complete. SID = 0x%02X", currentService);
  
      // 전송 완료 응답 (0x36 → 0x76)
      sendISOTP(0x75D,rsp,3);
      
      if (currentService == 0x36)
      {
        saveToFile();
      }
      else if(currentService != 0x34 && currentService != 0x37)
      {
        for(i=2; i<recievedLen;i++){
          buffer_service_request[i-2]=(char)recieved[i];
        }
        process_diag_request(buffer_service_request);
      }
    }
  }
}