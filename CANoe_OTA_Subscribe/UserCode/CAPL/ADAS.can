/*@!Encoding:949*/
includes
{
}

variables
{
  msTimer checkTimer;         
  float speed = 13.9; // 50 km/h × 0.27778 ≒ 13.89 m/s    
  float radarDistance = 0.0;   
  float brakeDistance = 0.0; 
  message msg_adas_ieb msg;
  
  char ECU_NAME[20] = "ADAS";
  message 0x000 ISOTP_MSG;
  int recievedLen=0;
  byte recieved[4098];
  int rxIndex;
  byte sn;
  byte rxExpectedSN = 1;
  int rxInProgress;
  int currentService;
  int ADASFlag = 0;
}

on start
{
  setTimer(checkTimer, 100); 
}

on timer checkTimer
{
  if(ADASFlag == 1){
    brakeDistance = (speed * speed) / (2.0 * 9.8); 
  
    if (radarDistance > 0.1 && radarDistance < brakeDistance)
    {
      msg.sig_adas_ieb_cmd = 1;
      output(msg);
    }
    
    else
    {
      msg.sig_adas_ieb_cmd = 0;
      output(msg);
    }
  }
  setTimer(checkTimer, 100); 
}

on sysvar ADAS::Radar
{
  radarDistance = @this;
}


// 수신 데이터 파일로 저장
void saveToFile()
{
  char file_version[10] = "1.0";
  char file_path[50] = "C:/TEAM_2_OTA/ADAS";
  char file_name[50] = "";
  char downloadData[4098];
  int downloadSize;
  dword fd;
  int i;
  downloadSize = 0;
  snprintf(file_name,50,"%s_Firmware_%s.txt",ECU_NAME,file_version);
  for(i=2; i<recievedLen;i++){
    downloadData[downloadSize++]=(char)recieved[i];
  }
  downloadData[downloadSize]='\0';
  setWritePath(file_path);
  fd = openFileWrite(file_name,0);
  if (fd == -1)
  {
    write("!! 파일 열기 실패: %s", file_name);
    return;
  }
  filePutString(downloadData, downloadSize, fd);
  write(">> 파일 저장 성공:%d %s",downloadSize, file_name);
  fileClose(fd);
}


void sendISOTP(dword target_address,byte data[], int len)
{
  int i;
  int index;
  int seqNum;
  message 0x7DF outmsg;//브로드캐스트(사용안함)
  
  index = 0;
  seqNum = 1;

  ISOTP_MSG.id = target_address;
  
  if (len <= 7)//single frame
  {

    ISOTP_MSG.byte(0) = 0x00 | len;
    for (i = 0; i < len; i++) ISOTP_MSG.byte(i+1) = data[i];
    for (i = len + 1; i < 8; i++) ISOTP_MSG.byte(i) = 0x00;
    ISOTP_MSG.dlc = len+1;
    
    output(ISOTP_MSG);
  }
  else//ff -> cf
  {
    ISOTP_MSG.byte(0) = 0x10 | ((len >> 8) & 0x0F);
    ISOTP_MSG.byte(1) = len & 0xFF;
    for (i = 0; i < 6; i++) ISOTP_MSG.byte(i+2) = data[index++];
    ISOTP_MSG.dlc = len+2;
    output(ISOTP_MSG);
    
    //flow control을 받은 다음 cf를 보내기 시작해야하는데, 그부분은 미구현. (flow control 없이 그냥 파일 전송)
    while (index < len)
    {
      int rest;
      int cfLen;
      ISOTP_MSG.byte(0) = 0x20 | (seqNum & 0x0F);
      rest = len - index;
      cfLen = (rest >= 7) ? 7 : rest;

      for (i = 0; i < cfLen; i++) ISOTP_MSG.byte(i+1) = data[index++];
      
      ISOTP_MSG.dlc = cfLen+1;
      output(ISOTP_MSG);

      seqNum++;
    }
  }
}

// 수신 메시지 핸들러 
// ***************CAN ID를 ECU마다 다르게 수정해야 함*****************
on message msg_adas_diag_request
{
  byte pci; 
  byte sid;
  int i;
  byte response[8];
  byte fc[3];//flow control message
  
  pci = this.byte(0);
  
  
  // Single Frame
  if ((pci & 0xF0) == 0x00)
  {
    recievedLen = pci & 0x0F;
    sid = this.byte(1);

    currentService = sid;

    //request에 대한 응답
    response[0] = sid + 0x40;
    response[1] = 0x00; // Dummy positive response data
    sendISOTP(0x769,response,2);

    // TransferData (0x36)이면 수신 대기
    if (sid == 0x36)
    {
      rxIndex = 0;
      rxInProgress = 1;
    }
    else if(sid == 0x37){
      ADASFlag = 1;
    }
  }
  

  // First Frame이 왔으면 응답후 CF 받기 시작
  else if ((pci & 0xF0) == 0x10)
  {
    recievedLen = ((pci & 0x0F) << 8) | this.byte(1);
    
    rxIndex = 0;

    for (i = 0; i < 6; i++)
      recieved[rxIndex++] = this.byte(i + 2);

    currentService = recieved[0]; // SID
    rxExpectedSN = 1;
    rxInProgress = 1;


    // FC (Flow Control) 응답 - 받을 블럭 크기랑 ST를 여기서 결정
    fc[0]=0x30;
    fc[1]=0x00;
    fc[2]=0x00;
    sendISOTP(0x769,fc,3);
  }

  // Consecutive Frame
  else if ((pci & 0xF0) == 0x20)
  {
    int rest;
    int copyLen;
    sn = pci & 0x0F;

    if (!rxInProgress) return;

    if (sn != (rxExpectedSN & 0x0F))
    {
      write("!! ADAS : SN mismatch. Expected %d, got %d", rxExpectedSN, sn);
      rxInProgress = 0;
      return;
    }

    rxExpectedSN++;

    rest = recievedLen - rxIndex;
    copyLen = (rest >= 7) ? 7 : rest;

    for (i = 0; i < copyLen; i++)
      recieved[rxIndex++] = this.byte(i + 1);

    if (rxIndex >= recievedLen)
    {
      byte rsp[3];
      rsp[0]=0x03;
      rsp[1]=0x76;
      rsp[2]=0x01;
      rxInProgress = 0;
      write(">> Data reception complete. SID = 0x%02X", currentService);
  
      
      if (currentService == 0x36)
      {
        saveToFile();
      }
      // 전송 완료 응답 (0x36 → 0x76)
      sendISOTP(0x769,rsp,3);
    }
  }
}